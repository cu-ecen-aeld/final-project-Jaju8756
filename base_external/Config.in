## base_external/Config.in
```kconfig
menu "Final Project TicTacToe"

source "$BR2_EXTERNAL_FINALPROJECT_PATH/package/tictactoe-rpi/Config.in"
source "$BR2_EXTERNAL_FINALPROJECT_PATH/package/aesd-char-driver/Config.in"

endmenu
```

## base_external/package/aesd-char-driver/Config.in
```kconfig
config BR2_PACKAGE_AESD_CHAR_DRIVER
    bool "aesd-char-driver"
    help
      Builds AESD character device driver
```

## base_external/package/tictactoe-rpi/Config.in
```kconfig
config BR2_PACKAGE_TICTACTOE_RPI
    bool "TicTacToe RPi"
    help
      User-space Tic-Tac-Toe application for Raspberry Pi 4.
```
